## hw/cxl/Kconfig
```kconfig
source vendor/Kconfig

config CXL
    bool
    default y if PCI_EXPRESS

config CXL_VENDOR
    bool
    default y

config I2C_MCTP_CXL
    bool
    default y if CXL && I2C_MCTP
```

## hw/cxl/vendor/skhynix/Kconfig
```kconfig
config CXL_SKHYNIX_NIAGARA
    bool
    depends on CXL_MEM_DEVICE
    default y if CXL_VENDOR
```
